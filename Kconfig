## src/Kconfig.basic
```kconfig
choice
	prompt "Firmware version select"

	config FIRMWARE_VERSION_202309
		bool "2023.09"

	config FIRMWARE_VERSION_201810
		bool "2018.10"
endchoice

config FIRMWARE_VERSION_STRING
	string
	default "2018.10" if FIRMWARE_VERSION_201810
	default "2023.09" if FIRMWARE_VERSION_202309

choice
	prompt "DRAM type select"

	config DRAM_TYPE_DDR3
		bool "DDR3"
		help
		  DDR3 and DDR3L DRAM types

	config DRAM_TYPE_DDR4
		bool "DDR4"
		help
		  DDR4 DRAM type

	config DRAM_TYPE_LPDDR4
		bool "LPDDR4"
		depends on !PLATFORM_SOLARIS
		help
		  LPDDR4 DRAM type
endchoice

choice
	prompt "DDRMCs select"

	config DDRMC_ACTIVE_0
		bool "DDRMC0"

	config DDRMC_ACTIVE_0_1
		bool "DDRMC0, DDRMC1"

	config DDRMC_ACTIVE_0_2
		bool "DDRMC0 - DDRMC2"
		depends on PLATFORM_SOLARIS

	config DDRMC_ACTIVE_0_3
		bool "DDRMC0 - DDRMC3"
		depends on PLATFORM_SOLARIS
endchoice

config DDRMC_ACTIVE_MASK
	int
	default 1 if DDRMC_ACTIVE_0
	default 3 if DDRMC_ACTIVE_0_1
	default 7 if DDRMC_ACTIVE_0_2
	default 15 if DDRMC_ACTIVE_0_3

config DDRMC_INIT_REQUIRED_MASK
	hex
	default 0x1 if PLATFORM_SOLARIS
	default 0x1 if PLATFORM_MCOM03 && !INTERLEAVING
	default 0x3 if PLATFORM_MCOM03 && INTERLEAVING

menuconfig INTERLEAVING
	bool "Memory interleaving"
	depends on (PLATFORM_MCOM03 && DDRMC_ACTIVE_0_1 || PLATFORM_SOLARIS && DDRMC_ACTIVE_0_3)
	default y

if INTERLEAVING

choice
	prompt "Interleaving size"

	config INTERLEAVING_SIZE_1K
		bool "1 KiB"
		depends on PLATFORM_SOLARIS

	config INTERLEAVING_SIZE_2K
		bool "2 KiB"
		depends on PLATFORM_SOLARIS

	config INTERLEAVING_SIZE_4K
		bool "4 KiB"
endchoice

config INTERLEAVING_SIZE
	int
	default 0 if INTERLEAVING_SIZE_1K
	default 1 if INTERLEAVING_SIZE_2K
	default 2 if INTERLEAVING_SIZE_4K

endif

config BURST_LEN
	int "DRAM burst length"
	default 8
	help
	  DRAM burst length

config UART_BAUDRATE
	int "UART Baudrate"
	default 115200
	help
	  UART baudrate

config UART_BASE_FREQ
	int "UART input frequency"
	default 40000000 if PLATFORM_SOLARIS
	help
	  UART input frequency in Hz

config DDR_XTAL_FREQ
	int "DDR XTAL frequency"
	default 25000000 if PLATFORM_SOLARIS
	help
	  DDR XTAL frequency in Hz

config PHY_PLL_BYPASS
	bool
	default n

choice
	prompt "DRAM rate select"
	depends on SPD_EEPROM && DRAM_RATE_CUSTOM || !SPD_EEPROM

	config DRAM_RATE_66
		depends on DRAM_TYPE_LPDDR4
		select PHY_PLL_BYPASS
		bool "66 MT/s"

	config DRAM_RATE_133
		depends on DRAM_TYPE_LPDDR4
		select PHY_PLL_BYPASS
		bool "133 MT/s"

	config DRAM_RATE_266
		depends on DRAM_TYPE_LPDDR4
		select PHY_PLL_BYPASS
		bool "266 MT/s"

	config DRAM_RATE_533
		depends on DRAM_TYPE_LPDDR4
		select PHY_PLL_BYPASS
		bool "533 MT/s"

	config DRAM_RATE_1066
		depends on !DRAM_TYPE_DDR4
		bool "1066 MT/s"

	config DRAM_RATE_1250
		depends on !DRAM_TYPE_DDR3
		bool "1250 MT/s"

	config DRAM_RATE_1333
		bool "1333 MT/s"

	config DRAM_RATE_1600
		bool "1600 MT/s"

	config DRAM_RATE_1866
		bool "1866 MT/s"

	config DRAM_RATE_2133
		bool "2133 MT/s"

	config DRAM_RATE_2400
		depends on !DRAM_TYPE_DDR3
		bool "2400 MT/s"

	config DRAM_RATE_2666
		depends on !DRAM_TYPE_DDR3
		bool "2666 MT/s"

	config DRAM_RATE_2933
		depends on !DRAM_TYPE_DDR3
		bool "2933 MT/s"

	config DRAM_RATE_3200
		depends on !DRAM_TYPE_DDR3
		bool "3200 MT/s"

endchoice

config DRAM_RATE
	int
	default 66 if DRAM_RATE_66
	default 133 if DRAM_RATE_133
	default 266 if DRAM_RATE_266
	default 533 if DRAM_RATE_533
	default 1066 if DRAM_RATE_1066
	default 1250 if DRAM_RATE_1250
	default 1333 if DRAM_RATE_1333
	default 1600 if DRAM_RATE_1600
	default 1866 if DRAM_RATE_1866
	default 2133 if DRAM_RATE_2133
	default 2400 if DRAM_RATE_2400
	default 2666 if DRAM_RATE_2666
	default 2933 if DRAM_RATE_2933
	default 3200 if DRAM_RATE_3200
	depends on SPD_EEPROM && DRAM_RATE_CUSTOM || !SPD_EEPROM

config READ_DBI
	bool "Enable read DBI"
	depends on DRAM_TYPE_DDR4 || DRAM_TYPE_LPDDR4
	default n
	help
	  Enable data bus inverted feature during read

config DRAM_CAS_RDBI_ADDITIONAL_LAT
	int
	default 0 if DRAM_RATE_66 || DRAM_RATE_133 || DRAM_RATE_266 || DRAM_RATE_533
	default 2 if DRAM_RATE_1066 || DRAM_RATE_1250 || DRAM_RATE_1600 || DRAM_RATE_1866
	default 2 if DRAM_TYPE_LPDDR4 && DRAM_RATE_2133
	default 3 if DRAM_TYPE_DDR4 && (DRAM_RATE_2133 || DRAM_RATE_2400 || DRAM_RATE_2666)
	default 4

config WRITE_DBI
        bool "Enable write DBI"
        depends on DRAM_TYPE_DDR4 || DRAM_TYPE_LPDDR4
        default n
        help
          Enable data bus inverted feature during write

menuconfig I2C
	bool "I2C support"
	default n

if I2C

config I2C_FREQ
	int "I2C input frequency"
	depends on PLATFORM_SOLARIS
	default 40000000
	help
	  I2C input frequency in Hz

choice
	prompt "I2C output frequency"

	config I2C_SPEED_100
		bool "100 KHz"

	config I2C_SPEED_400
		bool "400 KHz"
endchoice

config I2C_SPEED
	int
	default 100000 if I2C_SPEED_100
	default 400000 if I2C_SPEED_400

config DDR0_I2C
	int "I2C for DDR0"
	default 3 if PLATFORM_SOLARIS
	default 4 if PLATFORM_MCOM03
	help
	  I2C controller number that is used for DDR0 initialization.

config DDR1_I2C
	int "I2C for DDR1"
	default 3 if PLATFORM_SOLARIS
	default 4 if PLATFORM_MCOM03
	help
	  I2C controller number that is used for DDR1 initialization.

config DDR2_I2C
	int "I2C for DDR2"
	default 4 if PLATFORM_SOLARIS
	default -1 if PLATFORM_MCOM03
	help
	  I2C controller number that is used for DDR2 initialization.

config DDR3_I2C
	int "I2C for DDR3"
	default 4 if PLATFORM_SOLARIS
	default -1 if PLATFORM_MCOM03
	help
	  I2C controller number that is used for DDR3 initialization.

config DDR1_POWER_ENABLE
	bool "Enable DDR1 power on ELV-MC03-SMARC r1.1"
	depends on PLATFORM_MCOM03
	default n
	help
	  SW4 channel of PMIC on some ELV-MC03-SMARC r1.1 boards is
	  not enabled. This channel required for DDR1.

config SPD_EEPROM
	bool "SPD EEPROM"
	default n
	help
	  Get DRAM configuration from Serial Presence Detect (SPD) EEPROM

config DEBUG_SPD_DUMP
	bool "Dump SPD EEPROM"
	depends on SPD_EEPROM
	default n

choice
	prompt "DRAM rate select"
	depends on SPD_EEPROM

	config DRAM_RATE_SPD_MAXIMUM
		bool "Maximum DRAM rate from SPD"

	config DRAM_RATE_SPD_MINIMUM
		bool "Minimum DRAM rate from SPD"

	config DRAM_RATE_CUSTOM
		bool "Custom DRAM rate"
endchoice

config DIMM0_I2C_ADDR
	hex "DIMM0 I2C address"
	depends on SPD_EEPROM
	default 0x51
	help
	  DIMM0 I2C address

config DIMM1_I2C_ADDR
	hex "DIMM1 I2C address"
	depends on SPD_EEPROM
	default 0x52
	help
	  DIMM1 I2C address

config DIMM2_I2C_ADDR
	hex "DIMM2 I2C address"
	depends on SPD_EEPROM
	default 0x53
	help
	  DIMM2 I2C address

config DIMM3_I2C_ADDR
	hex "DIMM3 I2C address"
	depends on SPD_EEPROM
	default 0x54
	help
	  DIMM3 I2C address

config DIMM4_I2C_ADDR
	hex "DIMM4 I2C address"
	depends on SPD_EEPROM
	default 0x51
	help
	  DIMM4 I2C address

config DIMM5_I2C_ADDR
	hex "DIMM5 I2C address"
	depends on SPD_EEPROM
	default 0x52
	help
	  DIMM5 I2C address

config DIMM6_I2C_ADDR
	hex "DIMM6 I2C address"
	depends on SPD_EEPROM
	default 0x53
	help
	  DIMM6 I2C address

config DIMM7_I2C_ADDR
	hex "DIMM7 I2C address"
	depends on SPD_EEPROM
	default 0x54
	help
	  DIMM7 I2C address

endif

config DRAM_TCK
	int
	default 30016 if DRAM_RATE_66
	default 14992 if DRAM_RATE_133
	default 7504 if DRAM_RATE_266
	default 3748 if DRAM_RATE_533
	default 1876 if DRAM_RATE_1066
	default 1600 if DRAM_RATE_1250
	default 1500 if DRAM_RATE_1333
	default 1250 if DRAM_RATE_1600
	default 1071 if DRAM_RATE_1866
	default 937 if DRAM_RATE_2133
	default 833 if DRAM_RATE_2400
	default 750 if DRAM_RATE_2666
	default 682 if DRAM_RATE_2933
	default 625 if DRAM_RATE_3200
	depends on SPD_EEPROM && DRAM_RATE_CUSTOM || !SPD_EEPROM

config DRAM_RANKS
	int "Active DRAM ranks"
	range 1 4 if PLATFORM_SOLARIS
	range 1 2 if PLATFORM_MCOM03
	default 1
	depends on !SPD_EEPROM
	help
	  Number of active DRAM ranks

config TIMER_FREQ
	int "Timer frequency"
	default 27000000 if PLATFORM_MCOM03
	default 250000000 if PLATFORM_SOLARIS
	help
	  Timer clock source frequency.

config DEBUG_DDRCFG_PRINT
	bool "Print DDR configuration"
	default n
	depends on SPD_EEPROM

menuconfig DQ_MAPPING
	bool "DQ mapping"
	default n
	depends on PLATFORM_MCOM03

if DQ_MAPPING

menu "DDRMC0"

config DDRMC0_DQ_MAPPING_BYTE0
	hex "DQ mapping for byte 0"
	default 0x76543210
	help
	  Mapping of PHY DQn to DRAM DQm for DBYTE0. Bits [3:0] corresponds
	  to DRAM DQ0, [7:4] to DRAM DQ1 and so on. For example, if PHY DQ3
	  is connected to DRAM DQ0, set DDRMC0_DQ_MAPPING_BYTE0[3:0] to 3.

config DDRMC0_DQ_MAPPING_BYTE1
	hex "DQ mapping for byte 1"
	default 0x76543210
	help
	  See help of CONFIG_DDRMC0_DQ_MAPPING_BYTE0.

config DDRMC0_DQ_MAPPING_BYTE2
	hex "DQ mapping for byte 2"
	default 0x76543210
	help
	  See help of CONFIG_DDRMC0_DQ_MAPPING_BYTE0.

config DDRMC0_DQ_MAPPING_BYTE3
	hex "DQ mapping for byte 3"
	default 0x76543210
	help
	  See help of CONFIG_DDRMC0_DQ_MAPPING_BYTE0.

endmenu

menu "DDRMC1"

config DDRMC1_DQ_MAPPING_BYTE0
	hex "DQ mapping for byte 0"
	default 0x76543210
	help
	  Mapping of PHY DQn to DRAM DQm for DBYTE0. Bits [3:0] corresponds
	  to DRAM DQ0, [7:4] to DRAM DQ1 and so on. For example, if PHY DQ3
	  is connected to DRAM DQ0, set DDRMC1_DQ_MAPPING_BYTE0[3:0] to 3.

config DDRMC1_DQ_MAPPING_BYTE1
	hex "DQ mapping for byte 1"
	default 0x76543210
	help
	  See help of CONFIG_DDRMC1_DQ_MAPPING_BYTE0.

config DDRMC1_DQ_MAPPING_BYTE2
	hex "DQ mapping for byte 2"
	default 0x76543210
	help
	  See help of CONFIG_DDRMC1_DQ_MAPPING_BYTE0.

config DDRMC1_DQ_MAPPING_BYTE3
	hex "DQ mapping for byte 3"
	default 0x76543210
	help
	  See help of CONFIG_DDRMC1_DQ_MAPPING_BYTE0.

endmenu

endif
```
