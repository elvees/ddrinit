## src/plat/Kconfig.plat
```kconfig
choice
	prompt "Platform select"

	config PLATFORM_MCOM03
		bool "MCom-03"
		help
		  ELVEES MCom-03 SoC

	config PLATFORM_SOLARIS
		bool "Solaris"
		help
		  ELVEES Solaris SoC
endchoice

choice
	prompt "Architecture select"
	depends on PLATFORM_MCOM03

	config ARCH_MIPS32
		bool "Build for MIPS32"

	config ARCH_AARCH64
		bool "Build for AArch64"
endchoice

choice
	prompt "Bootloader select"
	depends on PLATFORM_MCOM03

	config BOOTLOADER_SBL
		bool "SBL/JTAG"
		help
		  Load and run ddrinit using SBL or JTAG

	config BOOTLOADER_BOOTROM
		bool "BootROM"
		help
		  Load and run ddrinit using BootROM
endchoice

config RAM_BASE
	hex
	default 0xa0000000 if PLATFORM_MCOM03 && ARCH_MIPS32
	default 0x00000000 if PLATFORM_MCOM03 && ARCH_AARCH64
	default 0xffffffff9ff14000 if PLATFORM_SOLARIS
	help
	  RAM base address

config RAM_SIZE
	hex
	default 0xF000 if PLATFORM_MCOM03 && ARCH_MIPS32
	help
	  RAM size

config UART_BASE
	hex
	default 0xA1750000 if PLATFORM_MCOM03 && ARCH_MIPS32
	default 0x1750000 if PLATFORM_MCOM03 && ARCH_AARCH64
	default 0xffffffffbcc40000 if PLATFORM_SOLARIS
	help
	  Base address of UART controller

config DDRSUB0_BASE
	hex
	default 0xA4000000 if PLATFORM_MCOM03 && ARCH_MIPS32
	default 0x4000000 if PLATFORM_MCOM03 && ARCH_AARCH64
	default 0xffffffffb9000000 if PLATFORM_SOLARIS
	help
	  Base address of DDR subsystem #0

config DDRSUB_GAP
	hex
	default 0x4000000 if PLATFORM_MCOM03
	default 0x400000 if PLATFORM_SOLARIS
	help
	  Gap to next DDR subsystem base address

config DDRMC_MAX_NUMBER
	int
	default 2 if PLATFORM_MCOM03
	default 4 if PLATFORM_SOLARIS
	help
	  Number of DDR controllers

config DDRMC_AXI_PORTS
	int
	default 11 if PLATFORM_MCOM03
	default 1 if PLATFORM_SOLARIS
	help
	  Number of AXI ports in each DDR controller

config DDRMC_OFFSET
	hex
	default 0x2000000 if PLATFORM_MCOM03
	default 0x100000 if PLATFORM_SOLARIS
	help
	  Offset of DDR controller's registers

config PHY_OFFSET
	hex
	default 0x0 if PLATFORM_MCOM03
	default 0x200000 if PLATFORM_SOLARIS
	help
	  Offset of DDR PHY's registers

config PHY_DBYTE_NUM
	int
	default 4 if PLATFORM_MCOM03
	default 9 if PLATFORM_SOLARIS
	help
	  Number of DBYTEs in DDR PHY

config PHY_ANIB_NUM
	int
	default 10 if PLATFORM_MCOM03
	default 12 if PLATFORM_SOLARIS
	help
	  Number of ANIBs in DDR PHY

config PHY_ANIB_OFFSET
	hex
	default 0
	help
	  Offset of ANIB registers in PHY address space

config PHY_DBYTE_OFFSET
	hex
	default 0x40000
	help
	  Offset of DBYTE registers in PHY address space

config PHY_MASTER_OFFSET
	hex
	default 0x80000
	help
	  Offset of MASTER registers in PHY address space

config PHY_IMEM_OFFSET
	hex
	default 0x140000
	help
	  Offset of IMEM registers in PHY address space

config PHY_IMEM_SIZE
	int
	default 32768
	help
	  DDR PHY IMEM size in bytes

config PHY_DMEM_OFFSET
	hex
	default 0x150000
	help
	  Offset of DMEM registers in PHY address space

config PHY_PIE_OFFSET
	hex
	default 0x240000
	help
	  Offset of PIE registers in PHY address space

config PHY_APBONLY_OFFSET
	hex
	default 0x340000
	help
	  Offset of APBONLY registers in PHY address space

config PHY_REG_INSTANCE_OFFSET
	hex
	default 0x1000
	help
	  PHY register instance offset

config PHY_DFI1_EXIST
	bool
	default true if PLATFORM_MCOM03
	default false if PLATFORM_SOLARIS

config MAX_MEM_REGIONS
	int
	default 4 if PLATFORM_MCOM03
	default 5 if PLATFORM_SOLARIS

config MEM_REGIONS_PHYS_ADDR
	hex "Memory info physical address"
	depends on PLATFORM_MCOM03
	default 0x882400000
	help
	  Physical address to write info on initialized DDR
	  to be passed to U-Boot.

config MEM_REGIONS_VIRT_ADDR
	hex "Memory info virtual address"
	default 0xC2000000 if PLATFORM_MCOM03 && ARCH_MIPS32
	default 0xA0000000 if PLATFORM_MCOM03 && ARCH_AARCH64
	default 0xffffffffa4000000 if PLATFORM_SOLARIS
	help
	  Virtual address to map CONFIG_MEM_REGIONS_PHYS_ADDR to.

config VMMU_TABLE_BASE
	hex
	depends on PLATFORM_MCOM03
	depends on ARCH_MIPS32
	default 0x80000000
	help
	  Physical address where VMMU table is located

config VMMU_VIRT_BASE_START
	hex
	depends on PLATFORM_MCOM03
	depends on ARCH_MIPS32
	default 0xC0000000
	help
	  Start address of virtual addresses

config VMMU_VIRT_SLOT_COUNT
	int
	depends on PLATFORM_MCOM03
	depends on ARCH_MIPS32
	default 256
	help
	  2MiB slot count to map to DDR high.

config MEM_REGION0_START
	hex
	default 0x80000000 if PLATFORM_MCOM03
	default 0x0 if PLATFORM_SOLARIS

config MEM_REGION0_SIZE
	hex
	default 0x40000000 if PLATFORM_MCOM03
	default 0x10000000 if PLATFORM_SOLARIS

config MEM_REGION1_START
	hex
	default 0x880000000 if PLATFORM_MCOM03
	default 0x8010000000 if PLATFORM_SOLARIS

config MEM_REGION1_SIZE
	hex
	default 0x380000000 if PLATFORM_MCOM03
	default 0xff0000000 if PLATFORM_SOLARIS

config MEM_REGION2_START
	hex
	default 0xC0000000 if PLATFORM_MCOM03
	default 0x9000000000 if PLATFORM_SOLARIS

config MEM_REGION2_SIZE
	hex
	default 0x40000000 if PLATFORM_MCOM03
	default 0x1000000000 if PLATFORM_SOLARIS

config MEM_REGION3_START
	hex
	default 0xC80000000 if PLATFORM_MCOM03
	default 0xA000000000 if PLATFORM_SOLARIS

config MEM_REGION3_SIZE
	hex
	default 0x380000000 if PLATFORM_MCOM03
	default 0x1000000000 if PLATFORM_SOLARIS

config MEM_REGION4_START
	hex
	default 0xB000000000 if PLATFORM_SOLARIS

config MEM_REGION4_SIZE
	hex
	default 0x1000000000 if PLATFORM_SOLARIS

config AXI_BUS_FREQUENCY
	int
	default 680000000 if PLATFORM_SOLARIS

config DDRINIT_JTAG_MAGIC_ADDRESS
	hex "Address to read magic from"
	depends on PLATFORM_MCOM03 && ARCH_AARCH64
	default 0x80800000
	help
	  If ddrinit is run on Aarch64, the CPU is put into an
	  endless loop reading the memory address defined by this
	  option until a special value 0xdeadc0de has been read.

config DDRINIT_RETURN_ADDRESS
	hex "Address to jump to after ddrinit"
	depends on PLATFORM_MCOM03 && ARCH_AARCH64
	default 0x80000000
	help
	  An address to jump to once a special value 0xdeadc0de
	  has been read from CONFIG_DDRINIT_JTAG_MAGIC_ADDRESS.
```
