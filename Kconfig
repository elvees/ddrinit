## Kconfig
```kconfig
mainmenu "DDR initializer"

menu "Basic options"

source "src/plat/Kconfig.plat"
source "src/Kconfig.basic"
source "src/ddrmc/Kconfig"

endmenu

menu "Advanced options"

source "src/Kconfig.advanced"

endmenu

menu "Build options"

source "Kconfig.build"

endmenu
```

## configs/aurora_defconfig
```kconfig
CONFIG_PLATFORM_SOLARIS=y
CONFIG_DRAM_TYPE_DDR4=y
CONFIG_DDRMC_ACTIVE_0_3=y
CONFIG_UART_BASE_FREQ=25000000
CONFIG_DRAM_RATE_2133=y
CONFIG_DRAM_PAGE_SIZE_2K=y
CONFIG_DRAM_DEVICE_WIDTH_X16=y
CONFIG_DRAM_ROW_ADDR_BITS=16
CONFIG_DRAM_COLUMN_ADDR_BITS=10
CONFIG_DRAM_BANK_ADDR_BITS=2
CONFIG_DRAM_BANK_GROUP_ADDR_BITS=1
CONFIG_DRAM_CAS_LATENCY=16
CONFIG_DRAM_TIMING_TRCD=15000
CONFIG_DRAM_TIMING_TRP=15000
CONFIG_DRAM_RTT_NOM_120=y
```

## configs/ecam03dm_defconfig
```kconfig
CONFIG_DRAM_TYPE_LPDDR4=y
CONFIG_BURST_LEN=16
CONFIG_UART_BASE_FREQ=27000000
CONFIG_DDR_XTAL_FREQ=27000000
# CONFIG_SPD_EEPROM is not set
CONFIG_DRAM_RATE_1066=y
CONFIG_DRAM_RANKS=2
CONFIG_DQ_MAPPING=y
CONFIG_DDRMC0_DQ_MAPPING_BYTE1=0x23764510
CONFIG_DDRMC0_DQ_MAPPING_BYTE2=0x57642310
CONFIG_DDRMC0_DQ_MAPPING_BYTE3=0x76453210
CONFIG_PHY_ODT_60=y
CONFIG_PHY_TX_IMPEDANCE_60=y
CONFIG_DRAM_RTT_NOM_60=y
CONFIG_DRAM_CA_ODT_40=y
CONFIG_SOC_ODT_60=y
CONFIG_BOOTMODE_JTAG=y
```

## configs/elvmc03q7-r2.8.1_defconfig
```kconfig
CONFIG_DRAM_TYPE_LPDDR4=y
CONFIG_DDRMC_ACTIVE_0_1=y
CONFIG_BURST_LEN=16
CONFIG_UART_BASE_FREQ=27000000
CONFIG_DDR_XTAL_FREQ=27000000
CONFIG_DRAM_RATE_2133=y
CONFIG_READ_DBI=y
CONFIG_WRITE_DBI=y
CONFIG_DRAM_RANKS=2
CONFIG_DQ_MAPPING=y
CONFIG_DDRMC0_DQ_MAPPING_BYTE0=0x57463021
CONFIG_DDRMC0_DQ_MAPPING_BYTE1=0x30745612
CONFIG_DDRMC0_DQ_MAPPING_BYTE2=0x06523417
CONFIG_DDRMC0_DQ_MAPPING_BYTE3=0x17604352
CONFIG_DDRMC1_DQ_MAPPING_BYTE0=0x76543201
CONFIG_DDRMC1_DQ_MAPPING_BYTE1=0x76345210
CONFIG_DDRMC1_DQ_MAPPING_BYTE2=0x70543216
CONFIG_DDRMC1_DQ_MAPPING_BYTE3=0x45132067
CONFIG_DRAM_DEVICE_WIDTH_X16=y
CONFIG_DRAM_ROW_ADDR_BITS=16
CONFIG_DRAM_COLUMN_ADDR_BITS=10
CONFIG_DRAM_BANK_ADDR_BITS=3
CONFIG_PHY_ODT_120=y
CONFIG_PHY_TX_IMPEDANCE_40=y
CONFIG_PHY_ATX_IMPEDANCE_40=y
CONFIG_DRAM_RTT_NOM_120=y
CONFIG_DRAM_CA_ODT_40=y
CONFIG_SOC_ODT_120=y
```

## configs/elvmc03smarc_defconfig
```kconfig
CONFIG_DRAM_TYPE_LPDDR4=y
CONFIG_BURST_LEN=16
CONFIG_UART_BASE_FREQ=27000000
CONFIG_DDR_XTAL_FREQ=27000000
CONFIG_DRAM_RATE_2133=y
CONFIG_I2C=y
CONFIG_I2C_SPEED_400=y
CONFIG_DDR1_POWER_ENABLE=y
CONFIG_DRAM_RANKS=2
CONFIG_DDRMC_ACTIVE_MASK=3
CONFIG_PHY_ODT_120=y
CONFIG_PHY_TX_IMPEDANCE_40=y
CONFIG_PHY_ATX_IMPEDANCE_40=y
CONFIG_DRAM_RTT_NOM_120=y
CONFIG_DRAM_CA_ODT_40=y
CONFIG_SOC_ODT_120=y
CONFIG_BOOTMODE_JTAG=y
```

## configs/mcom03-ip-ku-ddr4-r1.0_defconfig
```kconfig
CONFIG_DRAM_TYPE_DDR4=y
CONFIG_UART_BASE_FREQ=27000000
CONFIG_DDR_XTAL_FREQ=27000000
CONFIG_DRAM_RATE_1600=y
CONFIG_DRAM_RANKS=2
CONFIG_DRAM_PAGE_SIZE_1K=y
CONFIG_DRAM_ROW_ADDR_BITS=16
CONFIG_DRAM_COLUMN_ADDR_BITS=10
CONFIG_DRAM_BANK_ADDR_BITS=2
CONFIG_DRAM_BANK_GROUP_ADDR_BITS=2
CONFIG_DRAM_CAS_LATENCY=12
CONFIG_DRAM_TIMING_TRCD=13750
CONFIG_DRAM_TIMING_TRP=13750
```

## configs/mcom03-ip-ku-m1-r1.0_defconfig
```kconfig
CONFIG_DRAM_TYPE_DDR4=y
CONFIG_UART_BASE_FREQ=27000000
CONFIG_DDR_XTAL_FREQ=27000000
CONFIG_READ_DBI=y
CONFIG_WRITE_DBI=y
CONFIG_DRAM_RANKS=2
CONFIG_DRAM_PAGE_SIZE_1K=y
CONFIG_DRAM_ROW_ADDR_BITS=17
CONFIG_DRAM_COLUMN_ADDR_BITS=10
CONFIG_DRAM_BANK_ADDR_BITS=2
CONFIG_DRAM_BANK_GROUP_ADDR_BITS=2
CONFIG_DRAM_CAS_LATENCY=16
CONFIG_DRAM_TIMING_TRCD=13750
CONFIG_DRAM_TIMING_TRP=13750
CONFIG_DRAM_RTT_NOM_80=y
CONFIG_DRAM_RTT_WR_HIZ=y
CONFIG_DRAM_RTT_PARK_240=y
```

## configs/mcom03bub_defconfig
```kconfig
CONFIG_DRAM_TYPE_LPDDR4=y
CONFIG_BURST_LEN=16
CONFIG_UART_BASE_FREQ=27000000
CONFIG_DDR_XTAL_FREQ=27000000
# CONFIG_SPD_EEPROM is not set
CONFIG_DRAM_RATE_1066=y
CONFIG_DRAM_RANKS=2
CONFIG_DDRMC_ACTIVE_MASK=3
CONFIG_PHY_ODT_60=y
CONFIG_PHY_TX_IMPEDANCE_60=y
CONFIG_DRAM_RTT_NOM_60=y
CONFIG_DRAM_CA_ODT_40=y
CONFIG_SOC_ODT_60=y
CONFIG_DISABLE_CA_TRAINING=y
CONFIG_BOOTMODE_JTAG=y
```

## configs/mcom03bubjtag_defconfig
```kconfig
CONFIG_DRAM_TYPE_LPDDR4=y
CONFIG_BURST_LEN=16
CONFIG_UART_BASE_FREQ=27000000
CONFIG_DDR_XTAL_FREQ=27000000
# CONFIG_SPD_EEPROM is not set
CONFIG_DRAM_RATE_1066=y
CONFIG_DRAM_RANKS=2
CONFIG_DDRMC_ACTIVE_MASK=2
CONFIG_BOOTMODE_JTAG=y
```

## configs/pm03cam-osm-r1.04_defconfig
```kconfig
CONFIG_FIRMWARE_VERSION_201810=y
CONFIG_DRAM_TYPE_LPDDR4=y
CONFIG_BURST_LEN=16
CONFIG_UART_BASE_FREQ=27000000
CONFIG_DDR_XTAL_FREQ=27000000
CONFIG_DRAM_RATE_1866=y
CONFIG_READ_DBI=y
CONFIG_WRITE_DBI=y
CONFIG_DQ_MAPPING=y
CONFIG_DDRMC0_DQ_MAPPING_BYTE0=0x57462031
CONFIG_DDRMC0_DQ_MAPPING_BYTE1=0x23475610
CONFIG_DDRMC0_DQ_MAPPING_BYTE2=0x06523417
CONFIG_DDRMC1_DQ_MAPPING_BYTE1=0x76345210
CONFIG_DDRMC1_DQ_MAPPING_BYTE3=0x45231067
CONFIG_DRAM_DEVICE_WIDTH_X16=y
CONFIG_DRAM_ROW_ADDR_BITS=16
CONFIG_DRAM_COLUMN_ADDR_BITS=10
CONFIG_DRAM_BANK_ADDR_BITS=3
CONFIG_PHY_ODT_120=y
CONFIG_PHY_TX_IMPEDANCE_40=y
CONFIG_PHY_ATX_IMPEDANCE_40=y
CONFIG_DRAM_RTT_NOM_120=y
CONFIG_DRAM_CA_ODT_40=y
CONFIG_SOC_ODT_120=y
# CONFIG_ENABLE_CA_VREF_TRAINING is not set
```

## configs/pm03cam-r2.0_defconfig
```kconfig
CONFIG_FIRMWARE_VERSION_201810=y
CONFIG_DRAM_TYPE_LPDDR4=y
CONFIG_BURST_LEN=16
CONFIG_UART_BASE_FREQ=27000000
CONFIG_DDR_XTAL_FREQ=27000000
CONFIG_DRAM_RATE_2133=y
CONFIG_DRAM_RANKS=2
CONFIG_DQ_MAPPING=y
CONFIG_DDRMC_PORT_READ_TIMEOUT_MASK=0x5
CONFIG_DDRMC_PORT_WRITE_TIMEOUT_MASK=0x5
CONFIG_DDRMC0_DQ_MAPPING_BYTE0=0x57462031
CONFIG_DDRMC0_DQ_MAPPING_BYTE1=0x23476510
CONFIG_DDRMC0_DQ_MAPPING_BYTE2=0x76523410
CONFIG_DRAM_DEVICE_WIDTH_X16=y
CONFIG_DRAM_ROW_ADDR_BITS=16
CONFIG_DRAM_COLUMN_ADDR_BITS=10
CONFIG_DRAM_BANK_ADDR_BITS=3
CONFIG_PHY_ODT_120=y
CONFIG_PHY_TX_IMPEDANCE_40=y
CONFIG_DRAM_RTT_NOM_120=y
CONFIG_DRAM_CA_ODT_40=y
CONFIG_SOC_ODT_120=y
# CONFIG_ENABLE_CA_VREF_TRAINING is not set
CONFIG_PHY_TXSLEW_FALL_DQ=0xf
CONFIG_PHY_TXSLEW_FALL_AC=0xf
```

## configs/pm03cam_defconfig
```kconfig
CONFIG_DRAM_TYPE_LPDDR4=y
CONFIG_BURST_LEN=16
CONFIG_UART_BASE_FREQ=27000000
CONFIG_DDR_XTAL_FREQ=27000000
CONFIG_DRAM_RATE_2133=y
CONFIG_DRAM_RANKS=2
CONFIG_DQ_MAPPING=y
CONFIG_DDRMC_PORT_READ_TIMEOUT_MASK=0x5
CONFIG_DDRMC_PORT_WRITE_TIMEOUT_MASK=0x5
CONFIG_DDRMC0_DQ_MAPPING_BYTE0=0x23574610
CONFIG_DDRMC0_DQ_MAPPING_BYTE1=0x32745610
CONFIG_DDRMC0_DQ_MAPPING_BYTE2=0x16523470
CONFIG_DRAM_DEVICE_WIDTH_X16=y
CONFIG_DRAM_ROW_ADDR_BITS=16
CONFIG_DRAM_COLUMN_ADDR_BITS=10
CONFIG_DRAM_BANK_ADDR_BITS=3
CONFIG_PHY_ODT_120=y
CONFIG_PHY_TX_IMPEDANCE_40=y
CONFIG_DRAM_RTT_NOM_120=y
CONFIG_DRAM_CA_ODT_40=y
CONFIG_SOC_ODT_120=y
CONFIG_IMPEDANCE_CALIBRATION_DISABLE=y
CONFIG_PHY_CALPEXT_OVR=0x15
CONFIG_PHY_CALNINT_OVR=0xf
```

## configs/skifmsb-v2.0_defconfig
```kconfig
CONFIG_DRAM_TYPE_LPDDR4=y
CONFIG_DDRMC_ACTIVE_0_1=y
CONFIG_BURST_LEN=16
CONFIG_UART_BASE_FREQ=27000000
CONFIG_DDR_XTAL_FREQ=27000000
CONFIG_DRAM_RATE_1866=y
CONFIG_READ_DBI=y
CONFIG_WRITE_DBI=y
CONFIG_DRAM_RANKS=2
CONFIG_DRAM_DEVICE_WIDTH_X16=y
CONFIG_DRAM_ROW_ADDR_BITS=16
CONFIG_DRAM_COLUMN_ADDR_BITS=10
CONFIG_DRAM_BANK_ADDR_BITS=3
CONFIG_PHY_ODT_120=y
CONFIG_PHY_TX_IMPEDANCE_40=y
CONFIG_PHY_ATX_IMPEDANCE_40=y
CONFIG_DRAM_RTT_NOM_120=y
CONFIG_DRAM_CA_ODT_40=y
CONFIG_SOC_ODT_120=y
```

## configs/solarisbub_defconfig
```kconfig
CONFIG_PLATFORM_SOLARIS=y
CONFIG_DRAM_TYPE_DDR4=y
CONFIG_UART_BASE_FREQ=25000000
CONFIG_DRAM_RATE_CUSTOM=y
CONFIG_DRAM_RATE_2133=y
CONFIG_I2C_FREQ=25000000
CONFIG_DRAM_RTT_NOM_120=y
```

## configs/solarisbubns_defconfig
```kconfig
CONFIG_PLATFORM_SOLARIS=y
CONFIG_DRAM_TYPE_DDR4=y
CONFIG_BOOTMODE_NOSTART=y
CONFIG_DRAM_TCK=833
# CONFIG_SPD_EEPROM is not set
```

## configs/solarisddr3_defconfig
```kconfig
CONFIG_PLATFORM_SOLARIS=y
# CONFIG_INTERLEAVING is not set
CONFIG_UART_BASE_FREQ=25000000
CONFIG_DRAM_RATE_1600=y
CONFIG_DRAM_RANKS=2
CONFIG_DRAM_ROW_ADDR_BITS=16
CONFIG_DRAM_COLUMN_ADDR_BITS=10
CONFIG_DRAM_BANK_ADDR_BITS=3
CONFIG_DRAM_CAS_LATENCY=11
CONFIG_DRAM_TIMING_TRCD=13750
CONFIG_DRAM_TIMING_TRP=13750
CONFIG_PHY_ODT_60=y
CONFIG_PHY_TX_IMPEDANCE_60=y
CONFIG_DRAM_RTT_NOM_60=y
```

## configs/trustphonepm_defconfig
```kconfig
CONFIG_DRAM_TYPE_LPDDR4=y
CONFIG_BURST_LEN=16
CONFIG_UART_BASE_FREQ=27000000
CONFIG_DDR_XTAL_FREQ=27000000
# CONFIG_SPD_EEPROM is not set
CONFIG_DRAM_RATE_1066=y
CONFIG_DRAM_RANKS=2
CONFIG_DDRMC_ACTIVE_MASK=3
CONFIG_DQ_MAPPING=y
CONFIG_DDRMC0_DQ_MAPPING_BYTE0=0x23576410
CONFIG_DDRMC0_DQ_MAPPING_BYTE1=0x32764510
CONFIG_DDRMC0_DQ_MAPPING_BYTE3=0x76453210
CONFIG_DDRMC1_DQ_MAPPING_BYTE0=0x32764510
CONFIG_DDRMC1_DQ_MAPPING_BYTE1=0x76345210
CONFIG_DDRMC1_DQ_MAPPING_BYTE2=0x76532410
CONFIG_DDRMC1_DQ_MAPPING_BYTE3=0x74562310
CONFIG_PHY_ODT_60=y
CONFIG_PHY_TX_IMPEDANCE_60=y
CONFIG_DRAM_RTT_NOM_60=y
CONFIG_DRAM_CA_ODT_40=y
CONFIG_SOC_ODT_60=y
CONFIG_BOOTMODE_JTAG=y
```
