## src/Kconfig.advanced
```kconfig
choice
	prompt "PHY ODT select"

	config PHY_ODT_34
		bool "34 Ohms"
		help
		  TBD

	config PHY_ODT_40
		bool "40 Ohms"
		help
		  TBD

	config PHY_ODT_60
		bool "60 Ohms"
		help
		  TBD

	config PHY_ODT_80
		bool "80 Ohms"
		help
		  TBD

	config PHY_ODT_120
		bool "120 Ohms"
		help
		  TBD

	config PHY_ODT_240
		bool "240 Ohms"
		help
		  TBD

	config PHY_ODT_HIZ
		bool "HiZ"
		help
		  TBD
endchoice

choice
	prompt "PHY TX Impedance select"

	config PHY_TX_IMPEDANCE_34
		bool "34 Ohms"
		help
		  TBD

	config PHY_TX_IMPEDANCE_40
		bool "40 Ohms"
		help
		  TBD

	config PHY_TX_IMPEDANCE_60
		bool "60 Ohms"
		help
		  TBD

	config PHY_TX_IMPEDANCE_80
		bool "80 Ohms"
		help
		  TBD

	config PHY_TX_IMPEDANCE_120
		bool "120 Ohms"
		help
		  TBD

	config PHY_TX_IMPEDANCE_240
		bool "240 Ohms"
		help
		  TBD

	config PHY_TX_IMPEDANCE_HIZ
		bool "HiZ"
		help
		  TBD
endchoice

choice
	prompt "PHY ATX impedance select"

	config PHY_ATX_IMPEDANCE_20
		bool "20 Ohms"
		help
		  TBD

	config PHY_ATX_IMPEDANCE_24
		bool "24 Ohms"
		help
		  TBD

	config PHY_ATX_IMPEDANCE_40
		bool "40 Ohms"
		help
		  TBD

	config PHY_ATX_IMPEDANCE_60
		bool "60 Ohms"
		help
		  TBD

	config PHY_ATX_IMPEDANCE_120
		bool "120 Ohms"
		help
		  TBD
endchoice

choice
	prompt "DRAM RTT_NOM select"

	config DRAM_RTT_NOM_DISABLED
		bool "disabled"
		help
		  TBD

	config DRAM_RTT_NOM_34
		bool "34 Ohms"
		help
		  TBD

	config DRAM_RTT_NOM_40
		bool "40 Ohms"
		help
		  TBD

	config DRAM_RTT_NOM_48
		bool "48 Ohms"
		help
		  TBD

	config DRAM_RTT_NOM_60
		bool "60 Ohms"
		help
		  TBD

	config DRAM_RTT_NOM_80
		bool "80 Ohms"
		help
		  TBD

	config DRAM_RTT_NOM_120
		bool "120 Ohms"
		help
		  TBD

	config DRAM_RTT_NOM_240
		bool "240 Ohms"
		help
		  TBD
endchoice

choice
	prompt "DRAM RTT_WR select"

	config DRAM_RTT_WR_DISABLED
		bool "disabled"
		help
		  TBD

	config DRAM_RTT_WR_80
		bool "80 Ohms"
		help
		  TBD

	config DRAM_RTT_WR_120
		bool "120 Ohms"
		help
		  TBD

	config DRAM_RTT_WR_240
		bool "240 Ohms"
		help
		  TBD

	config DRAM_RTT_WR_HIZ
		bool "HiZ"
		help
		  TBD
endchoice

choice
	prompt "DRAM RTT_PARK select"

	config DRAM_RTT_PARK_DISABLED
		bool "disabled"
		help
		  TBD

	config DRAM_RTT_PARK_34
		bool "34 Ohms"
		help
		  TBD

	config DRAM_RTT_PARK_40
		bool "40 Ohms"
		help
		  TBD

	config DRAM_RTT_PARK_48
		bool "48 Ohms"
		help
		  TBD

	config DRAM_RTT_PARK_60
		bool "60 Ohms"
		help
		  TBD

	config DRAM_RTT_PARK_80
		bool "80 Ohms"
		help
		  TBD

	config DRAM_RTT_PARK_120
		bool "120 Ohms"
		help
		  TBD

	config DRAM_RTT_PARK_240
		bool "240 Ohms"
		help
		  TBD
endchoice

choice
	prompt "DRAM TX Impedance select"

	config DRAM_TX_IMPEDANCE_34
		bool "34 Ohms"
		help
		  TBD

	config DRAM_TX_IMPEDANCE_40
		bool "40 Ohms"
		depends on DRAM_TYPE_DDR3
		help
		  TBD

	config DRAM_TX_IMPEDANCE_48
		depends on !DRAM_TYPE_DDR3
		bool "48 Ohms"
		help
		  TBD
endchoice

choice
	prompt "DRAM CA ODT select"
	depends on DRAM_TYPE_LPDDR4

	config DRAM_CA_ODT_DISABLED
		bool "disabled"

	config DRAM_CA_ODT_40
		bool "40 Ohms"

	config DRAM_CA_ODT_48
		bool "48 Ohms"

	config DRAM_CA_ODT_60
		bool "60 Ohms"

	config DRAM_CA_ODT_80
		bool "80 Ohms"

	config DRAM_CA_ODT_120
		bool "120 Ohms"

	config DRAM_CA_ODT_240
		bool "240 Ohms"

endchoice

choice
	prompt "SoC ODT select"
	depends on DRAM_TYPE_LPDDR4

	config SOC_ODT_DISABLED
		bool "disabled"

	config SOC_ODT_40
		bool "40 Ohms"

	config SOC_ODT_48
		bool "48 Ohms"

	config SOC_ODT_60
		bool "60 Ohms"

	config SOC_ODT_80
		bool "80 Ohms"

	config SOC_ODT_120
		bool "120 Ohms"

	config SOC_ODT_240
		bool "240 Ohms"

endchoice

choice
	prompt "External calibration resistor select"

	config PHY_CALIBRATION_EXT_RESISTOR_240
		bool "240 Ohms"
		help
		  TBD

	config PHY_CALIBRATION_EXT_RESISTOR_120
		bool "120 Ohms"
		help
		  TBD

	config PHY_CALIBRATION_EXT_RESISTOR_40
		bool "40 Ohms"
		help
		  TBD
endchoice

config PHY_CALIBRATION_INTERVAL
	int "PHY calibration interval"
	default 9
	range 0 9
	help
	  TBD

config PHY_TXSLEW_FALL_DQ
	hex "TXSLEW_FALL_DQ"
	default 0x7 if PLATFORM_MCOM03
	default 0xf if PLATFORM_SOLARIS
	help
	  TBD

config PHY_TXSLEW_RISE_DQ
	hex "TXSLEW_RISE_DQ"
	default 0xf if PLATFORM_MCOM03
	default 0xf if PLATFORM_SOLARIS
	help
	  TBD

config PHY_TXSLEW_FALL_AC
	hex "TXSLEW_FALL_AC"
	default 0x9 if PLATFORM_MCOM03
	default 0xf if PLATFORM_SOLARIS
	help
	  TBD

config PHY_TXSLEW_RISE_AC
	hex "TXSLEW_RISE_AC"
	default 0xf if PLATFORM_MCOM03
	default 0xf if PLATFORM_SOLARIS
	help
	  TBD

config PHY_D4RX_PREAMBLE_LEN
	int "D4RX_PREAMBLE_LEN"
	default 1 if PLATFORM_MCOM03
	default 1 if PLATFORM_SOLARIS
	help
	  TBD

config PHY_D4TX_PREAMBLE_LEN
	int "D4TX_PREAMBLE_LEN"
	default 0 if PLATFORM_MCOM03
	default 0 if PLATFORM_SOLARIS
	help
	  TBD

config PHY_ADDR_MIRROR
	hex "ADDR_MIRROR"
	default 0 if PLATFORM_MCOM03
	default 0xa if PLATFORM_SOLARIS
	help
	  TBD

choice
	prompt "Read postamble"
	config READ_POSTAMBLE_0_5T
		bool "0.5 tCK"
		depends on DRAM_TYPE_LPDDR4
		help
		  Read postamble of 0.5 tCK
	config READ_POSTAMBLE_1_5T
		bool "1.5 tCK"
		depends on DRAM_TYPE_LPDDR4
		help
		  Read postamble of 1.5 tCK
endchoice

config DISABLE_CA_TRAINING
	bool "Disable CA training"
	depends on DRAM_TYPE_LPDDR3 || DRAM_TYPE_LPDDR4
	default false
	help
	  Disable Command/Address training step during PHY trainings.
	  Applicable only for LPDDR3/LPDDR4 devices.

config ENABLE_CA_VREF_TRAINING
	bool "Enable CA vref training"
	depends on DRAM_TYPE_LPDDR4
	default y
	help
	  Enable optional Command/Address vref training step during PHY
	  trainings.

config DDR_LOW_SIZE
	int "Memory size for DDR Low region"
	depends on PLATFORM_MCOM03
	range 256 1024
	default 256
	help
	  DDR memory size in MiB of each DDRMC that is mapped to DDR Low region.

choice
	prompt "Memory regions to pass to Linux"
	depends on PLATFORM_MCOM03

	config LINUX_DDR_HIGH_ONLY
		bool "DDR High only"

	config LINUX_DDR_LOW_ONLY
		bool "DDR Low only"

	config LINUX_DDR_LOW_HIGH
		bool "Both DDR Low and High"

endchoice

config IMPEDANCE_CALIBRATION_DISABLE
	bool "Disable impedance calibration"
	default false
	help
	  Disable automatic impedance calibration. In this case CalPExt and CalNInt
	  parameters are got from CONFIG_PHY_CALPEXT_OVR and CONFIG_PHY_CALNINT_OVR.

config PHY_CALPEXT_OVR
	hex "CalPExtOvr value"
	depends on IMPEDANCE_CALIBRATION_DISABLE
	default 0x0
	help
	  This value will be used as PHY CalPExt parameter

config PHY_CALNINT_OVR
	hex "CalNIntOvr value"
	depends on IMPEDANCE_CALIBRATION_DISABLE
	default 0x0
	help
	  This value will be used as PHY CalNInt parameter

config IMPEDANCE_CALIBRATION_PRINT_PARAMS
	bool "Print impedance calibration parameters"
	default false
	help
	  Print PHY CalPExt and CalNInt parameters

config DDRMC_HPR_PORT_MASK
	hex "HPR port mask"
	default 0x20
	help
	  If bit i is set in the mask, all read transactions from AXI port i will be marked
	  as High Priority Read (HPR) transactions in DDRMC.

	  Bit mapping (see MCom-03 user guide chapter 8.3, Table 8.2 for details):
	  Bit in the mask   DDRMC AXI port
	         0              SDR
	         1              PCIe
	         2              ISP
	         3              GPU
	         4              VPU
	         5              DP
	         6              CPU
	         7              SERVICE
	         8              HSPERIPH
	         9              LSPERIPH0
	         10             LSPERIPH1

config DDRMC_PORT_READ_TIMEOUT_MASK
	hex "Port read timeout mask"
	default 0x4
	help
	  If bit i is set in the mask, all read transactions from AXI port i will have the port
	  read timeout set to 1. It means that read requests from port i will have highest priority
	  in the DDRMC.
	  Bit mapping (see MCom-03 user guide chapter 8.3, Table 8.2 for details):
	  Bit in the mask   DDRMC AXI port
	         0              SDR
	         1              PCIe
	         2              ISP
	         3              GPU
	         4              VPU
	         5              DP
	         6              CPU
	         7              SERVICE
	         8              HSPERIPH
	         9              LSPERIPH0
	         10             LSPERIPH1

config DDRMC_PORT_WRITE_TIMEOUT_MASK
	hex "Port write timeout mask"
	default 0x4
	help
	  If bit i is set in the mask, all write transactions from AXI port i will have the port
	  write timeout set to 1. It means that write requests from port i will have highest
	  priority in the DDRMC.
	  Bit mapping (see MCom-03 user guide chapter 8.3, Table 8.2 for details):
	  Bit in the mask   DDRMC AXI port
	         0              SDR
	         1              PCIe
	         2              ISP
	         3              GPU
	         4              VPU
	         5              DP
	         6              CPU
	         7              SERVICE
	         8              HSPERIPH
	         9              LSPERIPH0
	         10             LSPERIPH1

config MCOM03_ARM_HANG_TEST
	bool "Build ddrinit for arm-hang-test"
	depends on PLATFORM_MCOM03
	help
	  arm-hang-test requires ddrinit to be built with special PLL settings.
```
